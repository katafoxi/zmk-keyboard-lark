## boards/shields/lark/Kconfig.defconfig
```kconfig
if SHIELD_LARK_DONGLE

    # Max 16 characters in keyboard name
    config ZMK_KEYBOARD_NAME
        default "LARKeyboard"

    config ZMK_SPLIT_ROLE_CENTRAL
        default y

    # Set this to the number of peripherals your dongle will have.
    # For a unibody, this would be 1. If you have left and right halves, set it to 2, etc.
    config ZMK_SPLIT_BLE_CENTRAL_PERIPHERALS
        default 2

    config ZMK_USB
	    default y

    # Set this to ZMK_SPLIT_BLE_CENTRAL_PERIPHERALS + your desired number of BT profiles (default is 5)
    config BT_MAX_CONN
        default 6

    # Set this to the same number as BT_MAX_CONN
    config BT_MAX_PAIRED
        default 6

endif

if SHIELD_LARK_LEFT || SHIELD_LARK_RIGHT || SHIELD_LARK_DONGLE

    config ZMK_SPLIT
        default y

endif

if SHIELD_LARK_LEFT

    config ZMK_SPLIT_ROLE_CENTRAL
        default y

endif
```

## boards/shields/lark/Kconfig.shield
```kconfig
# No whitespace after the comma or in the keyboard name!
config SHIELD_LARK_DONGLE
    def_bool $(shields_list_contains,lark_dongle)

config SHIELD_LARK_LEFT
    def_bool $(shields_list_contains,lark_left)

config SHIELD_LARK_RIGHT
    def_bool $(shields_list_contains,lark_right)
```

## config/Kconfig.defconfig
```kconfig
if SHIELD_LARK_LEFT

    config ZMK_KEYBOARD_NAME
        default "LARKeyboard"

    config ZMK_SPLIT_BLE_ROLE_CENTRAL
        default y
endif

if SHIELD_LARK_LEFT || SHIELD_LARK_RIGHT

    config ZMK_SPLIT
        default y

endif
```

## west.yml
```yaml
# manifest:
#   remotes:
#     - name: remote-name
#       url-base: https://github.com/remote-name
#   projects:
#     # Together with the above defined remote, this refers to a module located at
#     # https://github.com/remote-name/repository-name
#     - name: repository-name
#       remote: remote-name
#       # This points to a west manifest file in the remote module for further imports
#       import: west.yml

manifest:
  remotes:
    - name: zmkfirmware
      url-base: https://github.com/zmkfirmware
    - name: katafoxi
      url-base: https://github.com/katafoxi
  projects:
    - name: zmk
      remote: zmkfirmware
      revision: main
      import: app/west.yml
    - name: zmk-keyboards-lark
      remote: katafoxi
      revision: main
  self:
    path: config
```
